## Kconfig
```kconfig
#ESP-IDF Kconfig configuration file. Not used for ESP8266 RTOS/non-RTOS SDKs.

menuconfig ESPHTTPD_ENABLED
    bool "esphttpd"
    help
        Select this option to enable libesphttpd and show the submodule with libesphttpd configuration

config ESPHTTPD_MAX_CONNECTIONS
	int "Maximum amount of connections"
        depends on ESPHTTPD_ENABLED
	range 1 LWIP_MAX_SOCKETS
	default 6
	help
		Amount of concurrent connections esp-httpd can sustain. Cannot be more than the amount of sockets lwip supports.
		NOTE: Httpd instances can be limited to fewer connections with the HttpdxxxxEx() server creation functions.

config ESPHTTPD_STACK_SIZE
	int "Stack size of ESP-HTTPD task"
        depends on ESPHTTPD_ENABLED
	range 1024 16384
	default 4096
	help
		Stack size reserved for the esp-httpd main task plus CGIs.

config ESPHTTPD_SHUTDOWN_SUPPORT
	bool "Enable shutdown support"
	depends on ESPHTTPD_ENABLED
	default n
	help
		Add support for server shutdown. Adds ~500 bytes of code.

config ESPHTTPD_CORS_SUPPORT
    bool "CORS support"
        depends on ESPHTTPD_ENABLED
    help
        Enable support for CORS, cross origin resource sharing.
        NOTE: Requires 256 bytes of RAM for each connection (ESPHTTD_MAX_CONNECTIONS)

config ESPHTTPD_HTMLDIR
	string "Directory (on the build machine) where the static files served by the webserver are"
        depends on ESPHTTPD_ENABLED
	default "html/"

config ESPHTTPD_USEUGLIFYJS
	bool "Compress JS with uglifyjs"
        depends on ESPHTTPD_ENABLED
	default n
	help
		Compress JS files with the uglifyjs compressor. Needs uglifyjs installed.

config ESPHTTPD_SSL_SUPPORT
	bool "Enable SSL support"
        depends on ESPHTTPD_ENABLED
	default n
	help
		SSL connections require ~32k of ram each.

		Enabling this allows the server to be placed into ssl mode.

		SSL servers require certificates. Steps to use:
		- Place a 'cacert.der' and 'prvtkey.der' files in your app directory.

		- To create self certified certificates:
			$ openssl req -sha256 -newkey rsa:4096 -nodes -keyout key.pem -x509 -days 365 -out certificate.pem

		- To generate .der certificates/keys from .pem certificates/keys:
			$ openssl x509 -outform der -in certificate.pem -out certificate.der
			$ openssl rsa -outform der -in key.pem -out key.der

		- Create a 'component.mk' file in your app directory and add these lines to it:
			COMPONENT_EMBED_TXTFILES := cacert.der
			COMPONENT_EMBED_TXTFILES += prvtkey.der

config ESPHTTPD_BACKLOG_SUPPORT
	bool "Write data to backlog when it can't be sent"
        depends on ESPHTTPD_ENABLED
	default n
	help
		A non-os specific option. FreeRTOS uses blocking sockets so data will always be sent and there is
		no need for the backlog.

		If you are using FreeRTOS you'll save codespace by leaving this option disabled.
```
